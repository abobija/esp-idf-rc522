## Kconfig
```kconfig
menu "RC522"

    config RC522_PREVENT_SECTOR_TRAILER_WRITE
        bool "Prevent writing to the Sector Trailer block"
        default y
        help
            The Sector Trailer block stores authentication keys
            and access bits. Enabling this option prevents writing
            to the Trailer block. This is enabled by default to protect
            inexperienced users from accidentally overwriting keys or
            writing incorrect access bits, which could render the sector
            unusable.

endmenu
```

## test/sdkconfig.defaults
```kconfig
CONFIG_IDF_TARGET="linux"
CONFIG_IDF_TARGET_LINUX=y
CONFIG_UNITY_ENABLE_IDF_TEST_RUNNER=y
CONFIG_UNITY_ENABLE_COLOR=y
```
